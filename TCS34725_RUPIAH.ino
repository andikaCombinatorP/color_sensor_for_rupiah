#include <Wire.h>
#include <Adafruit_TCS34725.h>

Adafruit_TCS34725 tcs = Adafruit_TCS34725(TCS34725_INTEGRATIONTIME_50MS, TCS34725_GAIN_1X);

// Definisi RGB untuk uang Seribu, Lima Ribu, Dua Ribuan, Dua Puluh Ribu, Lima Puluh Ribu, Sepuluh Ribu, dan Seratus Ribu (40 warna masing-masing)
uint16_t uangColors[7][40][3] = {
  // Definisi warna untuk uang Seribu (indeks 0-39)
  {
{160, 225, 186},
  {189, 260, 177},
  {154, 219, 158},
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  {317, 446, 300},


  },
  // Definisi warna untuk uang Lima Ribu (indeks 0-39)
  {
   {516, 685, 386},
  {513, 682, 384},
  {498, 669, 376},
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  {499, 610, 394},


  },
  // Definisi warna untuk uang Dua Ribuan (indeks 0-39)
  {
     {722, 984, 656},
  {707, 975, 648},
  {690, 963, 638},
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  {318, 425, 343},


  },
  // Definisi warna untuk uang Dua Puluh Ribu (indeks 0-39)
  {
    {418, 715, 515},
  {416, 714, 514},
  {420, 717, 516},
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  {632, 942, 588},


  },
  // Definisi warna untuk uang Lima Puluh Ribu (indeks 0-39)
  {
 {516, 685, 386},
  {513, 682, 384},
  {498, 669, 376},
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  {499, 610, 394},


  },
  // Definisi warna untuk uang Sepuluh Ribu (indeks 0-39)
  {
   {357, 433, 299},
  {357, 433, 299},
  {355, 432, 298},
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  {371, 474, 330},


  },
  // Definisi warna untuk uang Seratus Ribu (indeks 0-39)
  {
 {261, 267, 218},
    {414, 405, 318},
    {610, 602, 460},
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    {377, 370, 291},


  }
};

uint16_t countMatches[6][30] = {0}; // Menghitung jumlah cocokan untuk setiap definisi warna uang (40 warna masing-masing)

void setup() {
  Wire.begin();
  Serial.begin(9600);

  if (tcs.begin()) {
    Serial.println("Sensor warna TCS34725 ditemukan.");
  } else {
    Serial.println("Tidak dapat menemukan sensor warna TCS34725. Periksa koneksi!");
    while (1);
  }
}

void loop() {
  uint16_t clear, red, green, blue;
  tcs.getRawData(&red, &green, &blue, &clear);

  // Bandingkan nilai RGB dengan definisi-definisi uang
  for (int i = 0; i < 7; i++) {
    for (int j = 0; j < 30; j++) {
      if (red >= uangColors[i][j][0] && red <= uangColors[i][j][0] + 30 &&
          green >= uangColors[i][j][1] && green <= uangColors[i][j][1] + 30 &&
          blue >= uangColors[i][j][2] && blue <= uangColors[i][j][2] + 30) {
        countMatches[i][j]++;
      } else {
        countMatches[i][j] = 0;
      }

      // Cek jika terdapat cocokan sebanyak 10 kali, maka cetak nilai uang
      if (countMatches[i][j] >= 10) {
        Serial.print("Uang terdeteksi: Denominasi ");
        if (i == 0) {
          Serial.print("Seribu");
        } else if (i == 1) {
          Serial.print("Lima Ribu");
        } else if (i == 2) {
          Serial.print("Dua Ribuan");
        } else if (i == 3) {
          Serial.print("Dua Puluh Ribu");
        } else if (i == 4) {
          Serial.print("Lima Puluh Ribu");
        } else if (i == 5) {
          Serial.print("Sepuluh Ribu");
        } else if (i == 6) {
          Serial.print("Seratus Ribu");
        }
        Serial.print(", Definisi ke-");
        Serial.println(j + 1);
        countMatches[i][j] = 0;  // Reset hitungan cocokan
      }
    }
  }
  delay(50);
}
